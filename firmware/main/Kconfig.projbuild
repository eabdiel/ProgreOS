## firmware/main/Kconfig.projbuild
```kconfig
menu "Progre OS"

config PROGRE_WIFI_SSID
    string "Commissioning Wi-Fi SSID"
    default ""

config PROGRE_WIFI_PASSWORD
    string "Commissioning Wi-Fi password"
    default ""


    config PROGRE_BRIDGE_HOST
        string "Progre Bridge host"
        default "127.0.0.1"
        help
            IPv4 address or hostname of the Progre Voice Bridge.

    config PROGRE_BRIDGE_PORT
        int "Progre Bridge port"
        range 1 65535
        default 8765
        help
            TCP port used by the Progre Voice Bridge.

endmenu
```

## firmware/sdkconfig.defaults
```kconfig
CONFIG_ESPTOOLPY_FLASHSIZE_16MB=y

CONFIG_ESP_CONSOLE_USB_SERIAL_JTAG=y
CONFIG_ESP_CONSOLE_UART_DEFAULT=n

CONFIG_LOG_DEFAULT_LEVEL_INFO=y
```
